## boards/shields/hailmary/Kconfig.defconfig
```kconfig
if SHIELD_HAILMARY

config ZMK_KEYBOARD_NAME
    default "hailmary"

if ZMK_DISPLAY

choice ZMK_DISPLAY_STATUS_SCREEN
    default ZMK_DISPLAY_STATUS_SCREEN_CUSTOM
endchoice

config LV_OBJ_LABEL
    default y

config I2C
    default y

config SSD1306
    default y

endif # ZMK_DISPLAY

if LVGL

config LV_Z_VDB_SIZE
    default 64

config LV_Z_MEM_POOL_SIZE
    default 8192

config LV_DPI_DEF
    default 148

config LV_Z_BITS_PER_PIXEL
    default 1

choice LV_COLOR_DEPTH
    default LV_COLOR_DEPTH_1
endchoice

endif # LVGL

endif # SHIELD_HAILMARY
```

## config/west.yml
```yaml
manifest:
  remotes:
    - name: zmkfirmware
      url-base: https://github.com/zmkfirmware
  projects:
    - name: zmk
      remote: zmkfirmware
      revision: main
      import: app/west.yml
    - name: zmk-config-nice_nano
      url: https://github.com/nicekeyboards/zmk-config-nice_nano
      revision: main
      path: modules/hardware/nice_nano
  self:
    path: config
```

## dts/bindings/behaviors/custom,behavior-raw-hid-log.yaml
```yaml
description: Raw HID log test behavior
compatible: "custom,behavior-raw-hid-log"
include: one_param.yaml
```

## dts/bindings/behaviors/custom,behavior-rawhidlog.yaml
```yaml
description: Raw HID test behavior
compatible: "custom,behavior-rawhidlog"
include: one_param.yaml
```

## modules/raw-hid/Kconfig
```kconfig
menuconfig RAW_HID
  bool "Raw HID interface"
  depends on USB_HID_DEVICE_COUNT >= 2
  help
    Enable a vendor-defined raw HID interface alongside the keyboard.
```
